## board/beaglebone/linux-3.2.defconfig
```kconfig
CONFIG_EXPERIMENTAL=y
# CONFIG_LOCALVERSION_AUTO is not set
CONFIG_DEFAULT_HOSTNAME="beaglebone"
# CONFIG_SWAP is not set
CONFIG_SYSVIPC=y
CONFIG_POSIX_MQUEUE=y
CONFIG_BSD_PROCESS_ACCT=y
CONFIG_BSD_PROCESS_ACCT_V3=y
CONFIG_IKCONFIG=y
CONFIG_IKCONFIG_PROC=y
CONFIG_NAMESPACES=y
CONFIG_BLK_DEV_INITRD=y
CONFIG_CC_OPTIMIZE_FOR_SIZE=y
# CONFIG_UID16 is not set
CONFIG_EMBEDDED=y
CONFIG_PERF_EVENTS=y
CONFIG_SLAB=y
CONFIG_MODULES=y
CONFIG_MODULE_FORCE_LOAD=y
CONFIG_MODULE_UNLOAD=y
CONFIG_MODULE_FORCE_UNLOAD=y
CONFIG_MODVERSIONS=y
CONFIG_BLK_DEV_INTEGRITY=y
CONFIG_ARCH_OMAP=y
CONFIG_OMAP_MUX_DEBUG=y
CONFIG_OMAP_MBOX_FWK=y
# CONFIG_OMAP_32K_TIMER is not set
# CONFIG_MACH_OMAP_GENERIC is not set
# CONFIG_ARCH_OMAP2 is not set
# CONFIG_ARCH_OMAP4 is not set
# CONFIG_SOC_OMAP3430 is not set
# CONFIG_MACH_OMAP3_BEAGLE is not set
# CONFIG_MACH_DEVKIT8000 is not set
# CONFIG_MACH_OMAP_LDP is not set
# CONFIG_MACH_OMAP3530_LV_SOM is not set
# CONFIG_MACH_OMAP3_TORPEDO is not set
# CONFIG_MACH_ENCORE is not set
# CONFIG_MACH_OVERO is not set
# CONFIG_MACH_OMAP3EVM is not set
# CONFIG_MACH_OMAP3517EVM is not set
# CONFIG_MACH_OMAP3_PANDORA is not set
# CONFIG_MACH_OMAP3_TOUCHBOOK is not set
# CONFIG_MACH_OMAP_3430SDP is not set
# CONFIG_MACH_NOKIA_RM680 is not set
# CONFIG_MACH_NOKIA_RX51 is not set
# CONFIG_MACH_OMAP_ZOOM2 is not set
# CONFIG_MACH_OMAP_ZOOM3 is not set
# CONFIG_MACH_CM_T35 is not set
# CONFIG_MACH_CM_T3517 is not set
# CONFIG_MACH_IGEP0020 is not set
# CONFIG_MACH_IGEP0030 is not set
# CONFIG_MACH_SBC3530 is not set
# CONFIG_MACH_OMAP_3630SDP is not set
# CONFIG_MACH_TI8168EVM is not set
# CONFIG_MACH_TI8148EVM is not set
# CONFIG_MACH_AM335XIAEVM is not set
CONFIG_OMAP3_EDMA=y
CONFIG_ARM_THUMBEE=y
CONFIG_ARM_ERRATA_430973=y
CONFIG_NO_HZ=y
CONFIG_HIGH_RES_TIMERS=y
CONFIG_THUMB2_KERNEL=y
CONFIG_ZBOOT_ROM_TEXT=0x0
CONFIG_ZBOOT_ROM_BSS=0x0
CONFIG_CMDLINE=" debug "
CONFIG_AUTO_ZRELADDR=y
CONFIG_CPU_FREQ=y
CONFIG_CPU_FREQ_STAT_DETAILS=y
CONFIG_CPU_FREQ_DEFAULT_GOV_USERSPACE=y
CONFIG_CPU_FREQ_GOV_POWERSAVE=y
CONFIG_CPU_FREQ_GOV_ONDEMAND=y
CONFIG_CPU_FREQ_GOV_CONSERVATIVE=y
CONFIG_BINFMT_MISC=y
# CONFIG_SUSPEND is not set
CONFIG_PM_DEBUG=y
CONFIG_NET=y
CONFIG_PACKET=y
CONFIG_UNIX=y
CONFIG_INET=y
CONFIG_IP_MULTICAST=y
CONFIG_IP_PNP=y
CONFIG_IP_PNP_DHCP=y
# CONFIG_INET_XFRM_MODE_TRANSPORT is not set
# CONFIG_INET_XFRM_MODE_TUNNEL is not set
# CONFIG_INET_XFRM_MODE_BEET is not set
# CONFIG_INET_LRO is not set
# CONFIG_INET_DIAG is not set
# CONFIG_IPV6 is not set
# CONFIG_WIRELESS is not set
CONFIG_RFKILL_REGULATOR=m
CONFIG_DEVTMPFS=y
CONFIG_DEVTMPFS_MOUNT=y
CONFIG_CONNECTOR=y
CONFIG_BLK_DEV_LOOP=y
CONFIG_BLK_DEV_RAM=y
CONFIG_BLK_DEV_RAM_COUNT=2
CONFIG_BLK_DEV_RAM_SIZE=65536
CONFIG_MISC_DEVICES=y
CONFIG_EEPROM_AT24=y
CONFIG_EEPROM_93CX6=m
CONFIG_NETDEVICES=y
CONFIG_MII=y
# CONFIG_NET_VENDOR_BROADCOM is not set
# CONFIG_NET_VENDOR_CHELSIO is not set
# CONFIG_NET_VENDOR_FARADAY is not set
# CONFIG_NET_VENDOR_INTEL is not set
# CONFIG_NET_VENDOR_MARVELL is not set
# CONFIG_NET_VENDOR_MICREL is not set
# CONFIG_NET_VENDOR_MICROCHIP is not set
# CONFIG_NET_VENDOR_NATSEMI is not set
# CONFIG_NET_VENDOR_SEEQ is not set
# CONFIG_NET_VENDOR_SMSC is not set
# CONFIG_NET_VENDOR_STMICRO is not set
CONFIG_TI_CPSW=y
CONFIG_SMSC_PHY=y
# CONFIG_WLAN is not set
# CONFIG_INPUT_MOUSEDEV is not set
CONFIG_INPUT_EVDEV=y
# CONFIG_INPUT_KEYBOARD is not set
# CONFIG_INPUT_MOUSE is not set
# CONFIG_SERIO is not set
CONFIG_VT_HW_CONSOLE_BINDING=y
# CONFIG_LEGACY_PTYS is not set
CONFIG_HW_RANDOM=y
CONFIG_RAW_DRIVER=m
CONFIG_I2C_CHARDEV=y
CONFIG_SPI=y
CONFIG_SPI_GPIO=m
CONFIG_SPI_OMAP24XX=y
CONFIG_SPI_SPIDEV=m
CONFIG_DEBUG_GPIO=y
CONFIG_GPIO_SYSFS=y
CONFIG_GPIO_TWL4030=y
CONFIG_POWER_SUPPLY=y
# CONFIG_HWMON is not set
CONFIG_WATCHDOG=y
CONFIG_OMAP_WATCHDOG=y
CONFIG_TWL4030_WATCHDOG=y
CONFIG_MFD_TPS65217=y
CONFIG_REGULATOR_DUMMY=y
CONFIG_REGULATOR_FIXED_VOLTAGE=y
CONFIG_REGULATOR_VIRTUAL_CONSUMER=y
CONFIG_REGULATOR_USERSPACE_CONSUMER=y
CONFIG_REGULATOR_GPIO=y
CONFIG_REGULATOR_TWL4030=y
CONFIG_REGULATOR_TPS65023=y
CONFIG_REGULATOR_TPS6507X=y
CONFIG_REGULATOR_TPS65217=y
# CONFIG_HID_SUPPORT is not set
# CONFIG_USB_SUPPORT is not set
CONFIG_MMC=y
CONFIG_MMC_UNSAFE_RESUME=y
CONFIG_MMC_OMAP_HS=y
CONFIG_NEW_LEDS=y
CONFIG_LEDS_CLASS=y
CONFIG_LEDS_GPIO=y
CONFIG_LEDS_TRIGGERS=y
CONFIG_LEDS_TRIGGER_TIMER=y
CONFIG_LEDS_TRIGGER_HEARTBEAT=y
CONFIG_LEDS_TRIGGER_BACKLIGHT=y
CONFIG_LEDS_TRIGGER_GPIO=y
CONFIG_LEDS_TRIGGER_DEFAULT_ON=y
CONFIG_UIO=m
CONFIG_UIO_PDRV=m
CONFIG_UIO_PDRV_GENIRQ=m
CONFIG_UIO_PRUSS=m
CONFIG_STAGING=y
CONFIG_IIO=y
CONFIG_IIO_BUFFER=y
CONFIG_IIO_SW_RING=y
CONFIG_IIO_KFIFO_BUF=y
# CONFIG_IOMMU_SUPPORT is not set
CONFIG_PM_DEVFREQ=y
CONFIG_DEVFREQ_GOV_USERSPACE=y
CONFIG_EXT2_FS=y
CONFIG_EXT4_FS=y
CONFIG_EXT4_FS_POSIX_ACL=y
CONFIG_FANOTIFY=y
CONFIG_MSDOS_FS=y
CONFIG_VFAT_FS=y
CONFIG_TMPFS=y
CONFIG_TMPFS_POSIX_ACL=y
CONFIG_NFS_FS=y
CONFIG_NFS_V3=y
CONFIG_NFS_V4=y
CONFIG_ROOT_NFS=y
CONFIG_NLS_CODEPAGE_437=y
CONFIG_NLS_ISO8859_1=y
CONFIG_NLS_UTF8=y
CONFIG_DEBUG_FS=y
CONFIG_DETECT_HUNG_TASK=y
CONFIG_SCHEDSTATS=y
CONFIG_TIMER_STATS=y
# CONFIG_DEBUG_BUGVERBOSE is not set
# CONFIG_FTRACE is not set
CONFIG_DEBUG_LL=y
CONFIG_EARLY_PRINTK=y
CONFIG_DEBUG_JTAG_ENABLE=y
```

## configs/beaglebone_erlang_defconfig
```kconfig
BR2_arm=y
BR2_cortex_a8=y
BR2_BACKUP_SITE="http://files.troodon-software.com/br"
BR2_JLEVEL=8
BR2_TOOLCHAIN_BUILDROOT_LARGEFILE=y
BR2_TOOLCHAIN_BUILDROOT_LOCALE=y
BR2_TOOLCHAIN_BUILDROOT_CXX=y
BR2_TOOLCHAIN_BUILDROOT_USE_SSP=y
BR2_TARGET_GENERIC_HOSTNAME="beaglebone"
BR2_TARGET_GENERIC_ISSUE="Erlang-BeagleBone"
BR2_ROOTFS_DEVICE_CREATION_DYNAMIC_DEVTMPFS=y
BR2_TARGET_GENERIC_GETTY_PORT="ttyO0"
# BR2_TARGET_GENERIC_REMOUNT_ROOTFS_RW is not set
BR2_ROOTFS_POST_BUILD_SCRIPT="board/nerves-project/beaglebone/post-build.sh"
BR2_PACKAGE_BUSYBOX_CONFIG="board/nerves-project/beaglebone/busybox_defconfig"
BR2_PACKAGE_LSOF=y
BR2_PACKAGE_STRACE=y
BR2_PACKAGE_PV=y
BR2_PACKAGE_GIT=y
BR2_PACKAGE_ERLANG=y
BR2_PACKAGE_ERLANG_HIPE=y
BR2_PACKAGE_AVAHI=y
BR2_PACKAGE_AVAHI_DAEMON=y
BR2_PACKAGE_DROPBEAR=y
BR2_PACKAGE_DROPBEAR_DISABLE_REVERSEDNS=y
BR2_PACKAGE_ETHTOOL=y
BR2_PACKAGE_RSYNC=y
BR2_PACKAGE_DIALOG=y
BR2_PACKAGE_UEMACS=y
BR2_TARGET_ROOTFS_EXT2=y
# BR2_TARGET_ROOTFS_TAR is not set
BR2_TARGET_UBOOT=y
BR2_TARGET_UBOOT_BOARDNAME="am335x_evm"
BR2_TARGET_UBOOT_CUSTOM_GIT=y
BR2_TARGET_UBOOT_CUSTOM_PATCH_DIR="board/nerves-project/beaglebone"
BR2_TARGET_UBOOT_CUSTOM_GIT_REPO_URL="git://arago-project.org/git/projects/u-boot-am33x.git"
BR2_TARGET_UBOOT_CUSTOM_GIT_VERSION="v2011.09_AM335xPSP_04.06.00.06"
BR2_TARGET_UBOOT_FORMAT_IMG=y
BR2_TARGET_UBOOT_MLO=y
BR2_LINUX_KERNEL=y
BR2_LINUX_KERNEL_CUSTOM_GIT=y
BR2_LINUX_KERNEL_CUSTOM_GIT_REPO_URL="git://github.com/koenkooi/linux.git"
BR2_LINUX_KERNEL_CUSTOM_GIT_VERSION="linux-ti33x-psp-3.2-r5a+gitr09e9651bcf2ee8d86685f2a8075bc6557b1d3b91"
BR2_LINUX_KERNEL_USE_CUSTOM_CONFIG=y
BR2_LINUX_KERNEL_CUSTOM_CONFIG_FILE="board/nerves-project/beaglebone/linux-3.2.9.config"
```

## configs/beaglebone_trace_defconfig
```kconfig
BR2_arm=y
BR2_cortex_a8=y
BR2_ARM_EABIHF=y
BR2_KERNEL_HEADERS_VERSION=y
BR2_DEFAULT_KERNEL_VERSION="3.8.12"
BR2_TOOLCHAIN_BUILDROOT_LARGEFILE=y
BR2_TOOLCHAIN_BUILDROOT_WCHAR=y
BR2_PTHREAD_DEBUG=y
BR2_PACKAGE_HOST_GDB=y
BR2_TOOLCHAIN_BUILDROOT_CXX=y
BR2_TARGET_GENERIC_HOSTNAME="beaglebone"
BR2_ROOTFS_DEVICE_CREATION_DYNAMIC_DEVTMPFS=y
BR2_TARGET_GENERIC_GETTY_PORT="ttyO0"
# BR2_TARGET_GENERIC_REMOUNT_ROOTFS_RW is not set
BR2_LINUX_KERNEL=y
BR2_LINUX_KERNEL_CUSTOM_GIT=y
BR2_LINUX_KERNEL_CUSTOM_REPO_URL="git://git.ti.com/ti-linux-kernel/ti-linux-kernel.git"
BR2_LINUX_KERNEL_CUSTOM_REPO_VERSION="935f6c2f82056d538b528272e2bdbb5c08d69a58"
BR2_LINUX_KERNEL_USE_CUSTOM_CONFIG=y
BR2_LINUX_KERNEL_CUSTOM_CONFIG_FILE="board/beaglebone/linux-trace-3.8.config"
BR2_LINUX_KERNEL_DTS_SUPPORT=y
BR2_LINUX_KERNEL_INTREE_DTS_NAME="am335x-bone"
BR2_PACKAGE_GDB=y
BR2_PACKAGE_KTAP=y
BR2_PACKAGE_LTTNG_BABELTRACE=y
BR2_PACKAGE_LTTNG_MODULES=y
BR2_PACKAGE_LTTNG_TOOLS=y
BR2_PACKAGE_OPROFILE=y
BR2_PACKAGE_PERF=y
BR2_PACKAGE_AM33X_CM3=y
BR2_PACKAGE_ELFUTILS=y
BR2_TARGET_ROOTFS_EXT2=y
BR2_TARGET_UBOOT=y
BR2_TARGET_UBOOT_BOARDNAME="am335x_evm"
BR2_TARGET_UBOOT_CUSTOM_VERSION=y
BR2_TARGET_UBOOT_CUSTOM_VERSION_VALUE="2013.04"
BR2_TARGET_UBOOT_FORMAT_IMG=y
BR2_TARGET_UBOOT_SPL=y
BR2_TARGET_UBOOT_SPL_NAME="MLO"
```

## package/am33x-cm3/Config.in
```kconfig
config BR2_PACKAGE_AM33X_CM3
	bool "am33x-cm3"
	help
	  Cortex-M3 binary blob for suspend-resume
```

## package/erlang-cowboy/Config.in
```kconfig
config BR2_PACKAGE_ERLANG_COWBOY
	bool "erlang-cowboy"
	depends on BR2_PACKAGE_ERLANG
	help
	  erlang-cowboy is a small, fast, modular HTTP server and socket acceptor pool.

	  http://gihub.com/extend/cowboy
```

## package/erlang-mochiweb/Config.in
```kconfig
config BR2_PACKAGE_ERLANG_MOCHIWEB
	bool "erlang-mochiweb"
	depends on BR2_PACKAGE_ERLANG
	help
	  MochiWeb is an Erlang library for building lightweight HTTP servers.

	  http://gihub.com/mochi/mochiweb
```

## package/erlang-rebar/Config.in
```kconfig
config BR2_PACKAGE_ERLANG_REBAR
	bool "erlang-rebar"
	depends on BR2_PACKAGE_ERLANG
	help
	  erlang-rebar is a sophisticated build-tool for Erlang projects that follows OTP principles.

	  http://gihub.com/basho/rebar
```

## package/erlang/Config.in
```kconfig
config BR2_PACKAGE_ERLANG
	bool "erlang"
	select BR2_PACKAGE_NCURSES
	help
	  Erlang is a functional programming language with support for
	  concurrency, fault-tolerance, and soft real-time.

	  http://www.erlang.org/

if BR2_PACKAGE_ERLANG

config BR2_PACKAGE_ERLANG_HIPE
        bool "HiPE - Experimental!"
        help
	  Enable HiPE support in Erlang. This is a highly experimental
	  feature right now.

menu "Core modules"
config BR2_PACKAGE_ERLANG_APPMON
        bool "appmon"
	select BR2_PACKAGE_ERLANG_WEBTOOL
        help
          Application monitor and debug tool for Erlang

config BR2_PACKAGE_ERLANG_ASN1
        bool "asn1"
        help
          asn1 module for Erlang

config BR2_PACKAGE_ERLANG_COMMON_TEST
        bool "common_test"
        help
          common_test module for Erlang

config BR2_PACKAGE_ERLANG_DEBUGGER
        bool "debugger"
        help
          debugger module for Erlang

config BR2_PACKAGE_ERLANG_DIALYZER
        bool "dialyzer"
        help
          dialyzer module for Erlang

config BR2_PACKAGE_ERLANG_INETS
        bool "inets"
        help
          A set of services such as a web server and an ftp client

config BR2_PACKAGE_ERLANG_MNESIA
        bool "mnesia"
        help
          mnesia module for Erlang

config BR2_PACKAGE_ERLANG_OBSERVER
        bool "observer"
        help
          observer module for Erlang

config BR2_PACKAGE_ERLANG_RUNTIME_TOOLS
        bool "runtime_tools module"
        help
          runtime_tools module for Erlang

config BR2_PACKAGE_ERLANG_SASL
        bool "sasl module"
        help
          sasl module for Erlang

config BR2_PACKAGE_ERLANG_SSH
        bool "ssh module"
        help
          ssh module for Erlang

config BR2_PACKAGE_ERLANG_SSL
        bool "ssl module"
	select BR2_PACKAGE_OPENSSL
        help
          ssl module for Erlang

config BR2_PACKAGE_ERLANG_TEST_SERVER
        bool "test_server module"
        help
          test_server module for Erlang

config BR2_PACKAGE_ERLANG_TOOLS
        bool "tools module"
        help
          tools module for Erlang

config BR2_PACKAGE_ERLANG_WEBTOOL
        bool "webtool module"
	select BR2_PACKAGE_ERLANG_INETS
        help
          WebTool application portal to web-based Erlang tools
endmenu

endif
```

## package/iioutils/Config.in
```kconfig
config BR2_PACKAGE_IIOUTILS
	bool "iioutils"
	select BR2_PACKAGE_LIBSYSFS
	help
	  Utility programs associate with the Linux kernel industrial I/O
	  framework. Similar in purpose to lsusb.

	  http://iioutils.sourceforge.net/
```

## package/ktap/Config.in
```kconfig
config BR2_PACKAGE_KTAP
	bool "ktap"
	depends on BR2_LINUX_KERNEL
	help
	  ktap is a script-based dynamic tracing tool for Linux

	  it uses a scripting language and lets users trace the Linux kernel
	  dynamically. ktap is designed to give operational insights with
	  interoperability that allows users to tune, troubleshoot and extend
	  kernel and application. It's similar with Linux Systemtap and
	  Solaris Dtrace.

	  ktap don't support kernels older than 3.1.

	  Your kernel must have CONFIG_EVENT_TRACING, 
	  CONFIG_PERF_EVENTS, and CONFIG_DEBUG_FS enabled to compile.

	  http://www.ktap.org

comment "ktap requires a linux kernel to be built"
	depends on !BR2_LINUX_KERNEL
```
